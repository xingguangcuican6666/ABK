## ddk/xingguang-ddk/Kconfig
```kconfig
config XINGGUANG_DDK
	bool "Xingguang DDK destructive action guard"
	depends on SECURITY
	depends on BLOCK
	default n
	help
	  Enable the Xingguang DDK LSM guard.

	  This guard registers early as an in-tree LSM and then arms protection
	  in stages. Early boot audits sensitive block and write paths only;
	  late init enables exec, gzexe, and ptrace tracking; root-manager or
	  module-load activity switches the full raw block-device policy on.
```

## zram/zstdp/Kconfig
```kconfig
# SPDX-License-Identifier: GPL-2.0-only

config CRYPTO_ZSTDP
	tristate "Zstdp"
	select CRYPTO_ALGAPI
	select CRYPTO_ACOMP2
	select XXHASH
	help
	  zstdp is a zram-oriented zstd variant with pre-split block handling.
	  ABK vendors the upstream zstd sources required by zstd_preSplit.c and
	  registers the compressor as "zstdp" / "zstdp-scomp".
```
